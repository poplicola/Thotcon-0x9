void konami(){
  int8_t menuItemsCount = 6;
  buttonStateEnter = digitalRead(buttonPinEnter);
  u8g2.firstPage();
  do {
    u8g2.setFont(u8g2_font_5x7_mf);
    u8g2.setFontRefHeightAll();
    u8g2.setDrawColor(1);
    drawMenu("POKEMON", curMenuItem, "Up\nDown\nLeft\nRight\nA\nB", menuItemsCount,0);
    buttonPress(menuItemsCount);
  } while (u8g2.nextPage() );
  
  // REMEMBER TO THROW IN DE-DUPE FOR BUTTONS
  // 0 0 1 1 2 3 2 3 4 5
  

  if(buttonStateEnter==LOW){
    if(curMenuItem==0){
      states[index_state]=0;
    }
    if(curMenuItem==1){
      states[index_state]=1;
    }
    if(curMenuItem==2){
      states[index_state]=2;
    }
    if(curMenuItem==3){
      states[index_state]=3;
    }
    if(curMenuItem==4){
      states[index_state]=4;
    }
    if(curMenuItem==5){
      states[index_state]=5;
    }
    index_state++;

    Serial.println(states[0]);
    Serial.println(states[1]);
    Serial.println(states[2]);
    Serial.println(states[3]);
    Serial.println(states[4]);
    Serial.println(states[5]);
    Serial.println(states[6]);
    Serial.println(states[7]);
    Serial.println(states[8]);
    Serial.println(states[9]);
 
    if(index_state>=10){
      if(states[0]==0 && states[1]==0 && states[2]==1 && states[3]==1 && states[4]==2 && states[5]==3 && states[6]==2 && states[7]==3 && states[8]==4 && states[9]==5){
        #define QRCode_width 58
        #define QRCode_height 58
        static unsigned char QRCode[] = {
            0xff, 0x3f, 0xff, 0x00, 0xff, 0xf3, 0xff, 0x03, 0xff, 0x3f, 0xff, 0x00,
           0xff, 0xf3, 0xff, 0x03, 0x03, 0x30, 0x33, 0x0f, 0x0c, 0x33, 0x00, 0x03,
           0x03, 0x30, 0x33, 0x0f, 0x0c, 0x33, 0x00, 0x03, 0xf3, 0x33, 0xf0, 0xff,
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           0xff, 0x3f, 0xc3, 0x33, 0xf3, 0x3f, 0xc0, 0x00 };
           u8g2.firstPage();
           do {
            u8g2.setFont(u8g2_font_5x7_mf);
            u8g2.setFontRefHeightAll();
            u8g2.setDrawColor(2);
            u8g2.setFontMode(1);
            u8g2.drawXBM( 0, 0, 58, 58, QRCode);
           } while (u8g2.nextPage() );
           delay(5000);
      } else {
         u8g2.firstPage();
         index_state = 0;
         do {
          u8g2.setFont(u8g2_font_5x7_mf);
          u8g2.setFontRefHeightAll();
          u8g2.setDrawColor(2);
          u8g2.setFontMode(1);
          u8g2.drawStr(0,10,"Incorrect Code");
          u8g2.drawStr(0,20,"Go Back: Press L && R "); 
         } while (u8g2.nextPage() );
         delay(5000);
      }
    }
    delay(1000);
  }
}
